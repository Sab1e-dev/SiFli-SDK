## customer/boards/eh-lb573/Kconfig.board
```kconfig
config FPGA
    bool 
    default y 

config TOUCH_IRQ_PIN
    int
    default 79

config LCD_BACKLIGHT_CONTROL_PIN
    int
    default 70
    
```

## customer/boards/eh-lb573/hcpu/Kconfig.board
```kconfig
config BSP_USING_BOARD_EH_LB573XXX
    bool
    select SOC_SF32LB57X
    select BF0_HCPU
    default y

rsource "../Kconfig.board"
```

## customer/boards/eh-lb573/lcpu/Kconfig.board
```kconfig
config BSP_USING_BOARD_EH_LB573XXX
    bool
    select SOC_SF32LB57X
    select BF0_LCPU
    default y

config ARCH
    string
    default "risc-v"

config RISCV
    bool
    default y
    
config LTO_SUPPORT
    bool
    default y
    
rsource "../Kconfig.board"
```

## customer/boards/eh-lb573_mpi3/hcpu/Kconfig.board
```kconfig
config BSP_USING_BOARD_EH_LB573XXX_MPI3
    bool
    select SOC_SF32LB57X
    select BF0_HCPU
    default y

rsource "../Kconfig.board"
```

## customer/boards/eh-lb573_mpi3/lcpu/Kconfig.board
```kconfig
config BSP_USING_BOARD_EH_LB573XXX_MPI3
    bool
    select SOC_SF32LB57X
    select BF0_LCPU
    default y

config ARCH
    string
    default "risc-v"

config RISCV
    bool
    default y
    
rsource "../Kconfig.board"
```

## customer/boards/fpga-57x_base/Kconfig.board
```kconfig
config FPGA
    bool 
    default y 

config TOUCH_IRQ_PIN
    int
    default 33

config LCD_BACKLIGHT_CONTROL_PIN
    int
    default 70
    
```

## customer/peripherals/camera/Kconfig
```kconfig
menu "Camera"

config BSP_USING_OV2640
    bool "Enable camera (ov2640)"
    select BSP_USING_DCMI
    select BSP_USING_I2C
    default n
    
config BSP_USING_GC032A
    bool "Enable camera (GC032A)"
    select BSP_USING_DCMI
    select BSP_USING_I2C
    default n
    
endmenu    
```
